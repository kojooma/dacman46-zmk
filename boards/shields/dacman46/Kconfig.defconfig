## boards/shields/dacman46/Kconfig.defconfig
```kconfig
if SHIELD_DACMAN46_LEFT

config ZMK_KEYBOARD_NAME
    default "DM-4x6"

config ZMK_SPLIT_ROLE_CENTRAL
    default y

endif

if SHIELD_DACMAN46_LEFT || SHIELD_DACMAN46_RIGHT

config ZMK_SPLIT
    default y

endif
```

## boards/shields/dacman46/Kconfig.shield
```kconfig
# Copyright (c) 2020 Pete Johanson
# SPDX-License-Identifier: MIT

config SHIELD_DACMAN46_LEFT
    def_bool $(shields_list_contains,dacman46_left)

config SHIELD_DACMAN46_RIGHT
    def_bool $(shields_list_contains,dacman46_right)
```
